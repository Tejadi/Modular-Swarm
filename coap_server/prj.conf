## Kconfig
```
#
# Copyright (c) 2020 Nordic Semiconductor ASA
#
# SPDX-License-Identifier: LicenseRef-Nordic-5-Clause
#

menu "Swarm node options"

config APP_GPS_HIGH_RATE
	bool "Reconfigure GPS to 57600 baud @ 5 Hz at boot"
	default n
	help
	  After the initial 9600 8N1 bring-up, push PMTK251 (57600 baud) and
	  PMTK220 (200 ms = 5 Hz) to the GPS module and switch the UART to 57600.
	  Leave disabled to stay at the Adafruit Ultimate GPS default of
	  9600 8N1 / 1 Hz.

endmenu

menu "Zephyr Kernel"
source "Kconfig.zephyr"
endmenu

module = COAP_SERVER
module-str = CoAP server
source "$(ZEPHYR_BASE)/subsys/logging/Kconfig.template.log_config"

module = OT_COAP_UTILS
module-str = OpenThread CoAP utils
source "$(ZEPHYR_BASE)/subsys/logging/Kconfig.template.log_config"
```

## prj.conf
```kconfig
#
# Copyright (c) 2020 Nordic Semiconductor
#
# SPDX-License-Identifier: LicenseRef-Nordic-5-Clause
#

# Enable OpenThread
CONFIG_OPENTHREAD=y

# nRF board library
CONFIG_DK_LIBRARY=y

# Enable OpenThread CoAP support API
CONFIG_OPENTHREAD_COAP=y

# --- Shell / console / logs on RTT, OFF the USB data channel -----------------
# The Jetson data link owns the USB CDC ACM port and must carry ONLY newline-
# delimited JSON, so every human/diagnostic stream is moved to SEGGER RTT.
# (Viewing the shell/logs requires an SWD probe — chosen per project decision.)
CONFIG_SHELL=y
CONFIG_OPENTHREAD_SHELL=y
CONFIG_SHELL_ARGC_MAX=26
CONFIG_SHELL_CMD_BUFF_SIZE=416
CONFIG_SHELL_BACKEND_SERIAL=n
CONFIG_SHELL_BACKEND_RTT=y
CONFIG_USE_SEGGER_RTT=y

# Logs + printk ride the RTT shell (CONFIG_SHELL_LOG_BACKEND), so the USB data
# port never sees console/log text. No separate UART/RTT log backend or UART
# console — those would either pollute the data port or clash on RTT channel 0.
CONFIG_LOG=y
CONFIG_LOG_PRINTK=y
CONFIG_UART_CONSOLE=n
CONFIG_LOG_BACKEND_UART=n

# --- USB CDC ACM upstream data link to the Jetson Orin Nano ------------------
# The nRF is the USB device; the Jetson is the host. The board's native config
# (boards/common/usb/cdc_acm_serial.dtsi + defconfig) already selects the modern
# USB device_next stack and registers + enables the single CDC ACM instance
# (board_cdc_acm_uart) at boot, so we do NOT re-enable USB ourselves — we just
# make the stack/class explicit and turn on line control for DTR detection.
CONFIG_USB_DEVICE_STACK_NEXT=y
CONFIG_USBD_CDC_ACM_CLASS=y
CONFIG_UART_LINE_CTRL=y
CONFIG_CDC_ACM_SERIAL_PRODUCT_STRING="nRF Swarm Data"

# --- node identity for the capability manifest ------------------------------
CONFIG_HWINFO=y

# --- hardware UART for the NMEA GPS (uart0 @ D6/D7, see board overlay) -------
CONFIG_SERIAL=y
CONFIG_UART_INTERRUPT_DRIVEN=y
CONFIG_RING_BUFFER=y

# --- float formatting for the JSON lat/lon/alt fields -----------------------
CONFIG_CBPRINTF_FP_SUPPORT=y

# Increase Settings storage size
CONFIG_PM_PARTITION_SIZE_SETTINGS_STORAGE=0x8000

# Same network Master Key for client and server
CONFIG_OPENTHREAD_NETWORKKEY="00:11:22:33:44:55:66:77:88:99:aa:bb:cc:dd:ee:ff"

CONFIG_MBEDTLS_SHA1_C=n
CONFIG_FPU=y

# Increase main stack size to meet networking requirements
CONFIG_MAIN_STACK_SIZE=4096
```

## boards/xiao_ble.overlay
```dts
/*
 * Seeed XIAO nRF52840 (non-Sense) — coap_server peripheral overlay.
 *
 * MINIMAL by design. It builds on the board's native xiao_ble devicetree and
 * deliberately does NOT redefine, duplicate, or override the board's built-in
 * USB / console / CDC-ACM nodes (see the board's
 * boards/common/usb/cdc_acm_serial.dtsi, which already provides
 * `board_cdc_acm_uart` and the zephyr,console / zephyr,shell-uart choices).
 * Routing the console off that port is handled purely in Kconfig (prj.conf),
 * not here, to avoid the overlay-vs-native conflicts that bit us before.
 *
 * This overlay only:
 *   1. Retunes the board's single hardware UART (uart0, already pinned to
 *      D6 = P1.11 TX / D7 = P1.12 RX) to the Adafruit Ultimate GPS default of
 *      9600 8N1, and
 *   2. Adds two `chosen` pointers so firmware finds the GPS UART and the
 *      (board-provided) CDC-ACM upstream data port without hard-coding labels.
 *
 * Adafruit Ultimate GPS Breakout v3 wiring (3.3V):
 *   GPS VIN -> 3V3
 *   GPS GND -> GND
 *   GPS TX  -> XIAO D7 (P1.12, nRF RX)
 *   GPS RX  -> XIAO D6 (P1.11, nRF TX)
 *
 * SPDX-License-Identifier: LicenseRef-Nordic-5-Clause
 */

&uart0 {
	/* The MTK3339 boots at 9600 8N1. 8N1 (no parity, 1 stop bit) is the
	 * nordic,nrf-uarte default, so only the baud rate needs overriding.
	 * Firmware may raise this to 57600 at runtime (CONFIG_APP_GPS_HIGH_RATE). */
	current-speed = <9600>;
};

/ {
	chosen {
		/* GPS NMEA UART (the board's hardware UART on D6/D7). */
		swarm,gps-uart = &uart0;
		/* Upstream JSON data link to the Jetson — the board's own CDC-ACM
		 * instance, referenced (not redefined) so we don't fork its config. */
		swarm,jetson-link = &board_cdc_acm_uart;
	};
};
```

## src/coap_server.c
```c
/*
 * Copyright (c) 2020 Nordic Semiconductor ASA
 *
 * SPDX-License-Identifier: LicenseRef-Nordic-5-Clause
 */

#include <zephyr/kernel.h>
#include <dk_buttons_and_leds.h>
#include <zephyr/logging/log.h>
#include <zephyr/net/openthread.h>
#include <openthread/thread.h>

#include "ot_coap_utils.h"
#include "gps.h"
#include "jetson_link.h"

LOG_MODULE_REGISTER(coap_server, CONFIG_COAP_SERVER_LOG_LEVEL);

#define OT_CONNECTION_LED DK_LED1
#define PROVISIONING_LED DK_LED3
#define LIGHT_LED DK_LED4

#define COAP_SERVER_WORKQ_STACK_SIZE 512
#define COAP_SERVER_WORKQ_PRIORITY 5

K_THREAD_STACK_DEFINE(coap_server_workq_stack_area, COAP_SERVER_WORKQ_STACK_SIZE);
static struct k_work_q coap_server_workq;

static struct k_work provisioning_work;

static struct k_timer led_timer;
static struct k_timer provisioning_timer;

static void on_light_request(uint8_t command)
{
	static uint8_t val;

	switch (command) {
	case THREAD_COAP_UTILS_LIGHT_CMD_ON:
		dk_set_led_on(LIGHT_LED);
		val = 1;
		break;

	case THREAD_COAP_UTILS_LIGHT_CMD_OFF:
		dk_set_led_off(LIGHT_LED);
		val = 0;
		break;

	case THREAD_COAP_UTILS_LIGHT_CMD_TOGGLE:
		val = !val;
		dk_set_led(LIGHT_LED, val);
		break;

	default:
		break;
	}
}

static void activate_provisioning(struct k_work *item)
{
	ARG_UNUSED(item);

	ot_coap_activate_provisioning();

	k_timer_start(&led_timer, K_MSEC(100), K_MSEC(100));
	k_timer_start(&provisioning_timer, K_SECONDS(5), K_NO_WAIT);

	LOG_INF("Provisioning activated");
}

static void deactivate_provisionig(void)
{
	k_timer_stop(&led_timer);
	k_timer_stop(&provisioning_timer);

	if (ot_coap_is_provisioning_active()) {
		ot_coap_deactivate_provisioning();
		LOG_INF("Provisioning deactivated");
	}
}

static void on_provisioning_timer_expiry(struct k_timer *timer_id)
{
	ARG_UNUSED(timer_id);

	deactivate_provisionig();
}

static void on_led_timer_expiry(struct k_timer *timer_id)
{
	static uint8_t val = 1;

	ARG_UNUSED(timer_id);

	dk_set_led(PROVISIONING_LED, val);
	val = !val;
}

static void on_led_timer_stop(struct k_timer *timer_id)
{
	ARG_UNUSED(timer_id);

	dk_set_led_off(PROVISIONING_LED);
}

static void on_button_changed(uint32_t button_state, uint32_t has_changed)
{
	uint32_t buttons = button_state & has_changed;

	if (buttons & DK_BTN4_MSK) {
		k_work_submit_to_queue(&coap_server_workq, &provisioning_work);
	}
}

static void on_thread_state_changed(otChangedFlags flags, void *user_data)
{
	if (flags & OT_CHANGED_THREAD_ROLE) {
		switch (otThreadGetDeviceRole(openthread_get_default_instance())) {
		case OT_DEVICE_ROLE_CHILD:
		case OT_DEVICE_ROLE_ROUTER:
		case OT_DEVICE_ROLE_LEADER:
			dk_set_led_on(OT_CONNECTION_LED);
			break;

		case OT_DEVICE_ROLE_DISABLED:
		case OT_DEVICE_ROLE_DETACHED:
		default:
			dk_set_led_off(OT_CONNECTION_LED);
			deactivate_provisionig();
			break;
		}
	}
}

static struct openthread_state_changed_callback ot_state_chaged_cb = {
	.otCallback = on_thread_state_changed};

int main(void)
{
	int ret;

	LOG_INF("Start CoAP-server sample");

	k_timer_init(&led_timer, on_led_timer_expiry, on_led_timer_stop);
	k_timer_init(&provisioning_timer, on_provisioning_timer_expiry, NULL);

	k_work_queue_init(&coap_server_workq);
	k_work_queue_start(&coap_server_workq, coap_server_workq_stack_area,
					K_THREAD_STACK_SIZEOF(coap_server_workq_stack_area),
					COAP_SERVER_WORKQ_PRIORITY, NULL);
	k_work_init(&provisioning_work, activate_provisioning);

	ret = ot_coap_init(&deactivate_provisionig, &on_light_request);
	if (ret) {
		LOG_ERR("Could not initialize OpenThread CoAP");
		goto end;
	}

	ret = dk_leds_init();
	if (ret) {
		LOG_ERR("Could not initialize leds, err code: %d", ret);
		goto end;
	}

	ret = dk_buttons_init(on_button_changed);
	if (ret) {
		LOG_ERR("Cannot init buttons (error: %d)", ret);
		goto end;
	}

	/* Sensor stack: register each sensor's descriptor with the registry, then
	 * bring up the upstream Jetson link. The link reads the registry at
	 * handshake time, so init order only needs sensors before the link. */
	gps_init();
	jetson_link_init();

	openthread_state_changed_callback_register(&ot_state_chaged_cb);
	openthread_run();

end:
	return 0;
}
```

## src/gps.c
```c
/*
 * gps.c — see gps.h.
 *
 * NMEA arrives on the chosen swarm,gps-uart. The RX ISR only reassembles raw
 * lines on CR/LF and hands them to a small parser thread via a message queue,
 * so no parsing (or float math) runs in interrupt context. The parser validates
 * the NMEA checksum, decodes RMC + GGA in a minmea style, and commits a
 * normalized fix under a spinlock. read_json() serializes that fix for the
 * sensor registry — raw NMEA never leaves this file.
 *
 * SPDX-License-Identifier: LicenseRef-Nordic-5-Clause
 */

#include <zephyr/kernel.h>
#include <zephyr/device.h>
#include <zephyr/devicetree.h>
#include <zephyr/drivers/uart.h>
#include <zephyr/logging/log.h>
#include <errno.h>
#include <stdio.h>
#include <stdlib.h>
#include <string.h>

#include "gps.h"
#include "sensor_registry.h"

LOG_MODULE_REGISTER(gps, CONFIG_COAP_SERVER_LOG_LEVEL);

#if DT_HAS_CHOSEN(swarm_gps_uart)
#define HAVE_GPS 1
static const struct device *const gps_uart = DEVICE_DT_GET(DT_CHOSEN(swarm_gps_uart));
#else
#define HAVE_GPS 0
#endif

#if HAVE_GPS

#define NMEA_MAX 96

struct nmea_line {
	char buf[NMEA_MAX];
};

/* ISR -> parser thread hand-off. Depth 4 absorbs a full 1 Hz sentence burst. */
K_MSGQ_DEFINE(gps_msgq, sizeof(struct nmea_line), 4, 4);

/* Latest committed fix, guarded by a spinlock (parser writes, readers copy). */
static struct k_spinlock fix_lock;
static struct gps_fix fix;

/* --- RX ISR: reassemble raw lines only --- */

static void gps_isr(const struct device *dev, void *user_data)
{
	static struct nmea_line cur;
	static uint8_t len;
	uint8_t c;

	ARG_UNUSED(user_data);

	if (!uart_irq_update(dev) || !uart_irq_rx_ready(dev)) {
		return;
	}
	while (uart_fifo_read(dev, &c, 1) == 1) {
		if (c == '\r' || c == '\n') {
			if (len > 6) {
				cur.buf[len] = '\0';
				(void)k_msgq_put(&gps_msgq, &cur, K_NO_WAIT);
			}
			len = 0;
		} else if (len < NMEA_MAX - 1) {
			cur.buf[len++] = (char)c;
		} else {
			len = 0; /* overrun — resync on next delimiter */
		}
	}
}

/* --- minmea-style parsing (parser thread context) --- */

static int split_fields(char *s, char **f, int max)
{
	int n = 0;

	f[n++] = s;
	for (char *p = s; *p && n < max; p++) {
		if (*p == ',') {
			*p = '\0';
			f[n++] = p + 1;
		}
	}
	return n;
}

/* ddmm.mmmm + hemisphere -> decimal degrees. */
static double nmea_coord(const char *val, const char *hemi)
{
	if (!val[0]) {
		return 0.0;
	}
	double v = atof(val);
	int deg = (int)(v / 100.0);
	double minutes = v - deg * 100.0;
	double dec = deg + minutes / 60.0;

	if (hemi[0] == 'S' || hemi[0] == 'W') {
		dec = -dec;
	}
	return dec;
}

static void nmea_time(const char *val, struct gps_fix *out)
{
	/* hhmmss.sss */
	if (strlen(val) < 6) {
		return;
	}
	out->hours   = (val[0] - '0') * 10 + (val[1] - '0');
	out->minutes = (val[2] - '0') * 10 + (val[3] - '0');
	out->seconds = (val[4] - '0') * 10 + (val[5] - '0');
	out->millis  = (val[6] == '.') ? (uint16_t)(atof(val + 6) * 1000.0) : 0;
}

/* $xxGGA,time,lat,N,lon,E,fixq,sats,hdop,alt,M,... */
static void parse_gga(char *s)
{
	char *f[16];
	int n = split_fields(s, f, 16);

	if (n < 10) {
		return;
	}
	int q = f[6][0] ? atoi(f[6]) : 0;
	int sats = f[7][0] ? atoi(f[7]) : 0;

	/* Log only on lock acquire/lose so RTT shows fix state without 1 Hz spam. */
	static int last_q = -1;
	if (q != last_q) {
		if (q > 0) {
			LOG_INF("GPS fix acquired: quality=%d sats=%d", q, sats);
		} else {
			LOG_INF("GPS fix lost (searching)");
		}
		last_q = q;
	}

	K_SPINLOCK(&fix_lock) {
		fix.fix_quality = (uint8_t)q;
		fix.satellites = (uint8_t)sats;
		fix.hdop = f[8][0] ? atof(f[8]) : 0.0;
		nmea_time(f[1], &fix);
		if (q > 0) {
			fix.latitude = nmea_coord(f[2], f[3]);
			fix.longitude = nmea_coord(f[4], f[5]);
			fix.altitude_m = f[9][0] ? atof(f[9]) : 0.0;
			fix.valid = true;
		} else {
			fix.valid = false;
		}
	}
}

/* $xxRMC,time,status,lat,N,lon,E,speed,course,date,... */
static void parse_rmc(char *s)
{
	char *f[14];
	int n = split_fields(s, f, 14);

	if (n < 8) {
		return;
	}
	bool active = (f[2][0] == 'A');

	K_SPINLOCK(&fix_lock) {
		nmea_time(f[1], &fix);
		if (active) {
			fix.latitude = nmea_coord(f[3], f[4]);
			fix.longitude = nmea_coord(f[5], f[6]);
			fix.valid = true;
		} else if (fix.fix_quality == 0) {
			/* No GGA fix either -> position is not trustworthy. */
			fix.valid = false;
		}
	}
}

static void parse_nmea(char *s)
{
	/* s is "$ttSSS,...*HH" without CR/LF. */
	if (s[0] != '$') {
		return;
	}
	char *star = strchr(s, '*');
	if (!star) {
		return;
	}
	*star = '\0';

	uint8_t want = (uint8_t)strtol(star + 1, NULL, 16);
	uint8_t have = 0;
	for (char *p = s + 1; *p; p++) {
		have ^= (uint8_t)*p;
	}
	if (have != want) {
		LOG_DBG("NMEA checksum mismatch");
		return;
	}

	const char *sentence = s + 3; /* skip '$' + 2-char talker id */
	if (!strncmp(sentence, "GGA", 3)) {
		parse_gga(s);
	} else if (!strncmp(sentence, "RMC", 3)) {
		parse_rmc(s);
	}
}

static void gps_thread_fn(void *a, void *b, void *c)
{
	struct nmea_line line;

	ARG_UNUSED(a);
	ARG_UNUSED(b);
	ARG_UNUSED(c);

	for (;;) {
		if (k_msgq_get(&gps_msgq, &line, K_FOREVER) == 0) {
			parse_nmea(line.buf);
		}
	}
}

/* 2 KB: NMEA parsing uses atof()/strtod() (picolibc double conv is stack-heavy). */
K_THREAD_STACK_DEFINE(gps_thread_stack, 2048);
static struct k_thread gps_thread;

/* --- PMTK configuration helpers --- */

static void gps_send_pmtk(const char *body)
{
	/* body is the payload between '$' and '*', e.g. "PMTK314,...". */
	uint8_t cs = 0;
	for (const char *p = body; *p; p++) {
		cs ^= (uint8_t)*p;
	}
	char line[80];
	int n = snprintf(line, sizeof(line), "$%s*%02X\r\n", body, cs);

	for (int i = 0; i < n && i < (int)sizeof(line); i++) {
		uart_poll_out(gps_uart, line[i]);
	}
}

/* --- sensor registry hook --- */

static int gps_read_json(char *buf, size_t cap)
{
	struct gps_fix f;

	/* Always report the current state so the link is never silent: until a
	 * lock is acquired this streams "fix":0 (lat/lon/etc. are 0). The
	 * consumer trusts the position only when "fix" > 0. */
	gps_get_fix(&f);
	return snprintf(buf, cap,
			"{\"fix\":%u,\"sats\":%u,\"lat\":%.7f,\"lon\":%.7f,"
			"\"alt_m\":%.1f,\"hdop\":%.1f,\"utc\":\"%02u%02u%02u.%03u\"}",
			f.fix_quality, f.satellites, f.latitude, f.longitude,
			f.altitude_m, f.hdop, f.hours, f.minutes, f.seconds,
			f.millis);
}

static const struct sensor_descriptor gps_desc = {
	.id = "gps0",
	.type = "gps",
	.units = "deg,m",
	.rate_hz = IS_ENABLED(CONFIG_APP_GPS_HIGH_RATE) ? 5 : 1,
	.transport = "uart",
	.read_json = gps_read_json,
};

bool gps_get_fix(struct gps_fix *out)
{
	bool valid;

	K_SPINLOCK(&fix_lock) {
		*out = fix;
		valid = fix.valid;
	}
	return valid;
}

int gps_init(void)
{
	if (!device_is_ready(gps_uart)) {
		LOG_ERR("GPS UART %s not ready", gps_uart->name);
		return -ENODEV;
	}

	/* (a) Restrict NMEA output to RMC + GGA only (PMTK314 fields:
	 *     GLL,RMC,VTG,GGA,GSA,GSV,... -> enable index 2 (RMC) and 4 (GGA)). */
	gps_send_pmtk("PMTK314,0,1,0,1,0,0,0,0,0,0,0,0,0,0,0,0,0,0,0");

	/* (b) Optionally raise to 57600 baud @ 5 Hz for a higher position rate. */
	if (IS_ENABLED(CONFIG_APP_GPS_HIGH_RATE)) {
		struct uart_config uc;

		gps_send_pmtk("PMTK251,57600"); /* tell the module to switch baud */
		k_msleep(150);
		if (uart_config_get(gps_uart, &uc) == 0) {
			uc.baudrate = 57600;
			if (uart_configure(gps_uart, &uc) != 0) {
				LOG_WRN("could not switch UART to 57600");
			}
		}
		gps_send_pmtk("PMTK220,200"); /* 200 ms fix interval = 5 Hz */
		LOG_INF("GPS reconfigured to 57600 baud @ 5 Hz");
	}

	uart_irq_callback_user_data_set(gps_uart, gps_isr, NULL);
	uart_irq_rx_enable(gps_uart);

	k_thread_create(&gps_thread, gps_thread_stack,
			K_THREAD_STACK_SIZEOF(gps_thread_stack), gps_thread_fn,
			NULL, NULL, NULL, K_PRIO_PREEMPT(7), 0, K_NO_WAIT);
	k_thread_name_set(&gps_thread, "gps");

	sensor_registry_register(&gps_desc);
	LOG_INF("GPS up on %s", gps_uart->name);
	return 0;
}

#else /* !HAVE_GPS */

int gps_init(void)
{
	LOG_INF("no GPS UART configured for this board");
	return -ENODEV;
}

bool gps_get_fix(struct gps_fix *out)
{
	ARG_UNUSED(out);
	return false;
}

#endif /* HAVE_GPS */
```

## src/gps.h
```c
/*
 * gps.h — Adafruit Ultimate GPS (MTK3339) NMEA driver.
 *
 * Reads NMEA off the board's hardware UART (chosen swarm,gps-uart), parses RMC
 * + GGA with a minmea-style parser into a normalized fix, and registers a "gps"
 * descriptor with the sensor registry. Raw NMEA is never exposed upstream.
 *
 * SPDX-License-Identifier: LicenseRef-Nordic-5-Clause
 */

#ifndef GPS_H__
#define GPS_H__

#include <stdbool.h>
#include <stdint.h>

/* Normalized fix. Degrees are decimal (+N/+E positive). */
struct gps_fix {
	bool     valid;        /* true once a usable position has been parsed   */
	uint8_t  fix_quality;  /* GGA fix quality: 0 none, 1 GPS, 2 DGPS, ...   */
	uint8_t  satellites;   /* satellites in use (GGA)                       */
	double   latitude;     /* decimal degrees, +N / -S                      */
	double   longitude;    /* decimal degrees, +E / -W                      */
	double   altitude_m;   /* MSL altitude in metres (optional, 0 if none)  */
	double   hdop;         /* horizontal dilution of precision (optional)   */
	uint8_t  hours;        /* UTC time of fix                               */
	uint8_t  minutes;
	uint8_t  seconds;
	uint16_t millis;
};

/* Bring up the GPS UART, push boot-time PMTK config (RMC+GGA only, optional
 * 57600/5Hz via CONFIG_APP_GPS_HIGH_RATE), start interrupt-driven NMEA RX, and
 * register the "gps" sensor descriptor. Returns 0 on success, <0 if no GPS UART
 * is configured for this board (in which case the node still runs without GPS).
 */
int gps_init(void);

/* Copy the most recent fix into *out. Returns true if a valid fix exists. */
bool gps_get_fix(struct gps_fix *out);

#endif /* GPS_H__ */
```

## src/jetson_link.c
```c
/*
 * jetson_link.c — see jetson_link.h.
 *
 * One CDC-ACM instance (chosen swarm,jetson-link) is the upstream data link.
 * TX is interrupt-driven through a ring buffer so a stalled host never blocks
 * the rest of the firmware; RX reassembles newline-delimited JSON and looks for
 * the host's ack. A single link thread drives the connection state machine:
 *
 *   wait for DTR (host opens port)
 *     -> announce manifest, retry with timeout/backoff until ack or give up
 *        -> on ack: stream normalized sensor data until DTR drops
 *   on a fresh DTR re-assert (reconnect): re-announce from the top.
 *
 * The announce/stream paths are sensor-count-agnostic: they walk the sensor
 * registry, so adding a sensor never touches this file.
 *
 * SPDX-License-Identifier: LicenseRef-Nordic-5-Clause
 */

#include <zephyr/kernel.h>
#include <zephyr/device.h>
#include <zephyr/devicetree.h>
#include <zephyr/drivers/uart.h>
#include <zephyr/drivers/hwinfo.h>
#include <zephyr/sys/ring_buffer.h>
#include <zephyr/logging/log.h>
#include <errno.h>
#include <stdio.h>
#include <string.h>

#include "protocol.h"
#include "sensor_registry.h"
#include "jetson_link.h"

LOG_MODULE_REGISTER(jetson_link, CONFIG_COAP_SERVER_LOG_LEVEL);

#if DT_HAS_CHOSEN(swarm_jetson_link)
#define HAVE_LINK 1
static const struct device *const link_dev = DEVICE_DT_GET(DT_CHOSEN(swarm_jetson_link));
#else
#define HAVE_LINK 0
#endif

#if HAVE_LINK

/* --- handshake / streaming tunables --- */
#define DTR_POLL_MS        100
#define HS_MAX_ATTEMPTS    6
#define HS_ACK_TIMEOUT_MS  1000
#define HS_BACKOFF_MIN_MS  500
#define HS_BACKOFF_MAX_MS  8000
#define STREAM_PERIOD_MS   1000

#define LINE_MAX      256
#define MANIFEST_MAX  512
#define VALUE_MAX     192
#define RX_MAX        256

RING_BUF_DECLARE(tx_rb, 2048);

static K_SEM_DEFINE(ack_sem, 0, 1);

/* --- TX --- */

static void emit_raw(const uint8_t *data, size_t len)
{
	if (ring_buf_put(&tx_rb, data, len) < len) {
		LOG_DBG("link TX overflow, dropping bytes");
	}
	uart_irq_tx_enable(link_dev);
}

static void emit_line(const char *json)
{
	const char term = PROTO_LINE_TERM;

	emit_raw((const uint8_t *)json, strlen(json));
	emit_raw((const uint8_t *)&term, 1);
}

/* --- RX: reassemble newline-delimited JSON, watch for the host ack --- */

static void rx_on_byte(uint8_t c)
{
	static char line[RX_MAX];
	static uint16_t len;

	if (c == '\r' || c == '\n') {
		if (len) {
			line[len] = '\0';
			/* Minimal ack detection — the contract guarantees the host
			 * replies with a {"type":"ack",...} object (see protocol.h). */
			if (strstr(line, "\"" PROTO_TYPE_ACK "\"")) {
				k_sem_give(&ack_sem);
			}
			len = 0;
		}
	} else if (len < RX_MAX - 1) {
		line[len++] = (char)c;
	} else {
		len = 0; /* overrun — resync on next newline */
	}
}

static void link_isr(const struct device *dev, void *user_data)
{
	uint8_t c;

	ARG_UNUSED(user_data);

	if (!uart_irq_update(dev)) {
		return;
	}
	while (uart_irq_rx_ready(dev)) {
		if (uart_fifo_read(dev, &c, 1) != 1) {
			break;
		}
		rx_on_byte(c);
	}
	while (uart_irq_tx_ready(dev)) {
		uint8_t b;

		if (ring_buf_get(&tx_rb, &b, 1) != 1) {
			uart_irq_tx_disable(dev);
			break;
		}
		uart_fifo_fill(dev, &b, 1);
	}
}

/* --- helpers --- */

static const char *node_id(void)
{
	static char id_str[20];

	if (id_str[0]) {
		return id_str;
	}
	uint8_t id[8];
	ssize_t n = hwinfo_get_device_id(id, sizeof(id));

	if (n <= 0) {
		strcpy(id_str, "node");
		return id_str;
	}
	for (ssize_t i = 0; i < n && i < 8; i++) {
		snprintf(id_str + i * 2, 3, "%02x", id[i]);
	}
	return id_str;
}

static bool link_dtr(void)
{
	uint32_t dtr = 0;

	if (uart_line_ctrl_get(link_dev, UART_LINE_CTRL_DTR, &dtr) != 0) {
		return false;
	}
	return dtr != 0;
}

/* Sleep up to ms, but bail early if the host disconnects. Returns true if DTR
 * stayed asserted the whole time. */
static bool dtr_sleep(uint32_t ms)
{
	while (ms) {
		uint32_t step = MIN(ms, (uint32_t)DTR_POLL_MS);

		k_msleep(step);
		ms -= step;
		if (!link_dtr()) {
			return false;
		}
	}
	return true;
}

static void emit_manifest(void)
{
	char line[MANIFEST_MAX];
	int n = sensor_registry_build_manifest(line, sizeof(line), node_id());

	if (n > 0) {
		emit_line(line);
	} else {
		LOG_ERR("manifest did not fit in %d bytes", (int)sizeof(line));
	}
}

static void emit_sensor_data(const struct sensor_descriptor *d)
{
	char value[VALUE_MAX];
	int vn = d->read_json(value, sizeof(value));

	if (vn < 0) {
		return; /* no valid sample yet */
	}
	char line[LINE_MAX];
	int n = snprintf(line, sizeof(line),
			 "{\"type\":\"%s\",\"schema\":%d,\"id\":\"%s\","
			 "\"ts_ms\":%lld,\"value\":%s}",
			 PROTO_TYPE_DATA, PROTO_SCHEMA_VERSION, d->id,
			 (long long)k_uptime_get(), value);

	if (n > 0 && n < (int)sizeof(line)) {
		emit_line(line);
	}
}

/* Announce + wait for ack with timeout/backoff. Returns true once acked. */
static bool handshake(void)
{
	uint32_t backoff = HS_BACKOFF_MIN_MS;

	for (int attempt = 1; attempt <= HS_MAX_ATTEMPTS; attempt++) {
		if (!link_dtr()) {
			return false; /* host went away mid-handshake */
		}
		k_sem_reset(&ack_sem);
		emit_manifest();

		if (k_sem_take(&ack_sem, K_MSEC(HS_ACK_TIMEOUT_MS)) == 0) {
			LOG_INF("manifest acked by host (attempt %d)", attempt);
			return true;
		}
		LOG_WRN("no ack (attempt %d/%d), backoff %u ms",
			attempt, HS_MAX_ATTEMPTS, backoff);
		if (!dtr_sleep(backoff)) {
			return false;
		}
		backoff = MIN(backoff * 2, (uint32_t)HS_BACKOFF_MAX_MS);
	}
	LOG_ERR("handshake gave up after %d attempts", HS_MAX_ATTEMPTS);
	return false;
}

static void stream_until_disconnect(void)
{
	LOG_INF("streaming %d sensor(s) to host", sensor_registry_count());
	while (link_dtr()) {
		int count = sensor_registry_count();

		for (int i = 0; i < count; i++) {
			const struct sensor_descriptor *d = sensor_registry_get(i);

			if (d) {
				emit_sensor_data(d);
			}
		}
		if (!dtr_sleep(STREAM_PERIOD_MS)) {
			break;
		}
	}
	LOG_INF("host disconnected (DTR dropped)");
}

static void link_thread_fn(void *a, void *b, void *c)
{
	bool prev_dtr = false;

	ARG_UNUSED(a);
	ARG_UNUSED(b);
	ARG_UNUSED(c);

	for (;;) {
		bool dtr = link_dtr();

		/* Fresh DTR assert == host opened (or reopened) the port. */
		if (dtr && !prev_dtr) {
			LOG_INF("host opened port — announcing capabilities");
			if (handshake()) {
				stream_until_disconnect();
			}
			dtr = link_dtr(); /* re-sample after the session */
		}
		prev_dtr = dtr;
		k_msleep(DTR_POLL_MS);
	}
}

/* 4 KB: the data path formats doubles (%.7f lat/lon) via picolibc, which is
 * stack-hungry on top of the line/value buffers — 2 KB could overflow on the
 * first streamed sample (right after ACK). */
K_THREAD_STACK_DEFINE(link_thread_stack, 4096);
static struct k_thread link_thread;

int jetson_link_init(void)
{
	if (!device_is_ready(link_dev)) {
		LOG_ERR("Jetson link %s not ready", link_dev->name);
		return -ENODEV;
	}

	/* USB and this CDC ACM instance are brought up automatically by the
	 * board's device_next serial-backend init (CDC_ACM_SERIAL_*_AT_BOOT),
	 * so we only attach our IRQ handler and drive the link state machine. */
	uart_irq_callback_user_data_set(link_dev, link_isr, NULL);
	uart_irq_rx_enable(link_dev);

	k_thread_create(&link_thread, link_thread_stack,
			K_THREAD_STACK_SIZEOF(link_thread_stack), link_thread_fn,
			NULL, NULL, NULL, K_PRIO_PREEMPT(7), 0, K_NO_WAIT);
	k_thread_name_set(&link_thread, "jetson_link");

	LOG_INF("Jetson link up on %s (node %s)", link_dev->name, node_id());
	return 0;
}

#else /* !HAVE_LINK */

int jetson_link_init(void)
{
	LOG_INF("no Jetson data port configured for this board");
	return -ENODEV;
}

#endif /* HAVE_LINK */
```

## src/jetson_link.h
```c
/*
 * jetson_link.h — upstream USB-CDC-ACM data link to the Jetson Orin Nano.
 *
 * The nRF is the USB device; the Jetson is the host. This link emits ONLY
 * newline-delimited JSON per protocol.h. It detects the host opening the port
 * via CDC-ACM DTR, announces a capability manifest (built from the sensor
 * registry), waits for the host ack with timeout/backoff, then streams
 * normalized sensor data. It re-announces on every reconnect.
 *
 * SPDX-License-Identifier: LicenseRef-Nordic-5-Clause
 */

#ifndef JETSON_LINK_H__
#define JETSON_LINK_H__

/* Enable USB, bring up the CDC-ACM data port, and start the link thread.
 * Returns 0 on success, <0 if no data port is configured for this board. */
int jetson_link_init(void);

#endif /* JETSON_LINK_H__ */
```

## src/protocol.h
```c
/*
 * protocol.h — canonical upstream contract between the nRF swarm node and the
 * Jetson Orin Nano over the USB-CDC-ACM data link.
 *
 * The link carries ONLY newline-delimited JSON: every frame is exactly one
 * JSON object followed by a single '\n'. Raw sensor wire data (e.g. NMEA) is
 * NEVER forwarded — only normalized values serialized in the shapes below.
 *
 * This file is the single source of truth for that contract; firmware must not
 * emit a field name or message type that is not described here.
 *
 *
 * 1. Manifest  (node -> host)  — capability discovery.
 *    Emitted when the host opens the port (CDC-ACM DTR asserted) and
 *    re-emitted on every reconnect. Count-agnostic: the `sensors` array simply
 *    lists every descriptor in the on-device sensor registry.
 *
 *      {"type":"manifest","schema":1,"node":"<hex-id>",
 *       "sensors":[
 *         {"id":"gps0","type":"gps","units":"deg,m","rate_hz":1,"transport":"uart"}
 *       ]}
 *
 * 2. Ack  (host -> node)  — handshake acknowledgement.
 *    The host replies with this after accepting a manifest. The node retries
 *    the manifest with timeout/backoff until it sees an ack (or gives up), then
 *    begins streaming. Minimum accepted form:
 *
 *      {"type":"ack","schema":1}
 *
 * 3. Data  (node -> host)  — one normalized sample, streamed after ack.
 *    The envelope is sensor-agnostic; `value` is whatever the sensor's
 *    descriptor serializes for itself.
 *
 *      {"type":"data","schema":1,"id":"gps0","ts_ms":12345,
 *       "value":{"fix":1,"sats":7,"lat":37.1234567,"lon":-122.1234567,
 *                "alt_m":12.3,"hdop":1.2,"utc":"123519.000"}}
 *
 * SPDX-License-Identifier: LicenseRef-Nordic-5-Clause
 */

#ifndef SWARM_PROTOCOL_JSON_H__
#define SWARM_PROTOCOL_JSON_H__

/* Bump whenever an incompatible change is made to any shape above. Carried in
 * every node->host object and echoed in the host's ack. */
#define PROTO_SCHEMA_VERSION 1

/* "type" discriminator values. */
#define PROTO_TYPE_MANIFEST "manifest" /* node -> host: capability manifest    */
#define PROTO_TYPE_DATA     "data"     /* node -> host: one normalized sample   */
#define PROTO_TYPE_ACK      "ack"      /* host -> node: manifest acknowledged   */

/* Every frame is one JSON object terminated by this byte. */
#define PROTO_LINE_TERM '\n'

#endif /* SWARM_PROTOCOL_JSON_H__ */
```

## src/sensor_registry.c
```c
/*
 * sensor_registry.c — see sensor_registry.h.
 *
 * SPDX-License-Identifier: LicenseRef-Nordic-5-Clause
 */

#include <zephyr/kernel.h>
#include <zephyr/logging/log.h>
#include <errno.h>
#include <stdarg.h>
#include <stdio.h>
#include <string.h>

#include "protocol.h"
#include "sensor_registry.h"

LOG_MODULE_REGISTER(sensor_registry, CONFIG_COAP_SERVER_LOG_LEVEL);

static const struct sensor_descriptor *registry[SENSOR_REGISTRY_MAX];
static int registry_count;

int sensor_registry_register(const struct sensor_descriptor *desc)
{
	if (!desc || !desc->id || !desc->type || !desc->read_json) {
		return -EINVAL;
	}
	if (registry_count >= SENSOR_REGISTRY_MAX) {
		LOG_ERR("sensor registry full, dropping '%s'", desc->id);
		return -ENOMEM;
	}
	registry[registry_count++] = desc;
	LOG_INF("registered sensor '%s' (type=%s, %u Hz, %s)", desc->id,
		desc->type, desc->rate_hz, desc->transport ? desc->transport : "?");
	return 0;
}

int sensor_registry_count(void)
{
	return registry_count;
}

const struct sensor_descriptor *sensor_registry_get(int idx)
{
	if (idx < 0 || idx >= registry_count) {
		return NULL;
	}
	return registry[idx];
}

/* Append to buf at *off, bounds-checked. Returns false (and leaves *off past
 * cap) if it would overflow, so callers can bail with a single check. */
static bool append(char *buf, size_t cap, int *off, const char *fmt, ...)
{
	if (*off < 0 || (size_t)*off >= cap) {
		*off = cap; /* poison */
		return false;
	}
	va_list ap;
	va_start(ap, fmt);
	int n = vsnprintf(buf + *off, cap - *off, fmt, ap);
	va_end(ap);
	if (n < 0 || (size_t)(*off + n) >= cap) {
		*off = cap;
		return false;
	}
	*off += n;
	return true;
}

int sensor_registry_build_manifest(char *buf, size_t cap, const char *node_id)
{
	int off = 0;

	if (!append(buf, cap, &off,
		    "{\"type\":\"%s\",\"schema\":%d,\"node\":\"%s\",\"sensors\":[",
		    PROTO_TYPE_MANIFEST, PROTO_SCHEMA_VERSION,
		    node_id ? node_id : "")) {
		return -1;
	}

	for (int i = 0; i < registry_count; i++) {
		const struct sensor_descriptor *d = registry[i];

		if (!append(buf, cap, &off,
			    "%s{\"id\":\"%s\",\"type\":\"%s\",\"units\":\"%s\","
			    "\"rate_hz\":%u,\"transport\":\"%s\"}",
			    i ? "," : "", d->id, d->type,
			    d->units ? d->units : "",
			    d->rate_hz, d->transport ? d->transport : "")) {
			return -1;
		}
	}

	if (!append(buf, cap, &off, "]}")) {
		return -1;
	}
	return off;
}
```

## src/sensor_registry.h
```c
/*
 * sensor_registry.h — universal capability-discovery abstraction.
 *
 * Each sensor registers a descriptor at init time. The Jetson handshake builds
 * its capability manifest by walking this registry, so adding a new sensor is
 * just another sensor_registry_register() call at boot — the handshake/manifest
 * logic never changes and is not aware of how many (or which) sensors exist.
 *
 * SPDX-License-Identifier: LicenseRef-Nordic-5-Clause
 */

#ifndef SENSOR_REGISTRY_H__
#define SENSOR_REGISTRY_H__

#include <stddef.h>
#include <stdint.h>

#ifndef SENSOR_REGISTRY_MAX
#define SENSOR_REGISTRY_MAX 8
#endif

struct sensor_descriptor {
	const char *id;        /* stable unique id, e.g. "gps0"               */
	const char *type;      /* sensor class, e.g. "gps"                    */
	const char *units;     /* human/units hint, e.g. "deg,m"              */
	uint16_t    rate_hz;   /* nominal sample rate                         */
	const char *transport; /* how it is attached, e.g. "uart"             */

	/* Serialize the latest normalized sample as a JSON object value
	 * (INCLUDING the surrounding { }). Return the number of bytes written
	 * (excluding the NUL), or a negative value if no valid sample exists
	 * yet (in which case no "data" frame is emitted for this tick).
	 */
	int (*read_json)(char *buf, size_t cap);
};

/* Register a descriptor. The pointer must remain valid for the program's life
 * (typically a static const). Returns 0 on success, -ENOMEM if the registry is
 * full, -EINVAL on a bad descriptor. */
int sensor_registry_register(const struct sensor_descriptor *desc);

/* Number of registered descriptors. */
int sensor_registry_count(void);

/* Descriptor at index [0, count), or NULL if out of range. */
const struct sensor_descriptor *sensor_registry_get(int idx);

/* Build the capability manifest line (no trailing '\n') into buf: a single
 * JSON object with the schema version, the node id, and the full descriptor
 * array. Returns bytes written (excluding NUL), or -1 if it did not fit. */
int sensor_registry_build_manifest(char *buf, size_t cap, const char *node_id);

#endif /* SENSOR_REGISTRY_H__ */
```
